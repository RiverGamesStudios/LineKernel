## Kconfig.template
```kconfig
# SPDX-License-Identifier: GPL-3.0-or-later
# SPDX-FileCopyrightText: Copyright (C) 2026 River Games

mainmenu "LineKernel/{ARCH} {VERSION} Configuration"

source "kernel/Kconfig"

source "{ARCH}/Kconfig"
```

## i386/Kconfig
```kconfig
config VGA_CONSOLE
    bool "vga console"
    default y
    help
      Enable VGA console?
    depends on CONSOLE

config SERIAL_CONSOLE
    bool "serial console"
    default y
    help
      Enable serial console?
    depends on CONSOLE

config PS2_KEYBOARD
    bool "ps2 keyboard"
    default y
    help
      Enable PS/2 keyboard support?
```

## kernel/Kconfig
```kconfig
# SPDX-License-Identifier: GPL-3.0-or-later
# SPDX-FileCopyrightText: Copyright (C) 2026 River Games

config GPT
    bool "gpt partition table"
    default y
    help
      Enable GPT partition table?

config CONSOLE
    bool "console support"
    default y
    help
      Enable console support?
```

## riscv64/Kconfig
```kconfig
# SPDX-License-Identifier: GPL-3.0-or-later
# SPDX-FileCopyrightText: Copyright (C) 2026 River Games

config UART
    bool "uart console"
    default y
    help
      Enable UART console? This works similar to serial.
    depends on CONSOLE
```

## x86_64/Kconfig
```kconfig
# SPDX-License-Identifier: GPL-3.0-or-later
# SPDX-FileCopyrightText: Copyright (C) 2026 River Games

config SERIAL_CONSOLE
    bool "serial console"
    default y
    help
      Enable serial console?
    depends on CONSOLE

config PS2_KEYBOARD
    bool "ps2 keyboard"
    default y
    help
      Enable PS/2 keyboard support?
```
